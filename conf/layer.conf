## conf/layer.conf
```bitbake
# We have a conf and classes directory, add to BBPATH
BBPATH .= ":${LAYERDIR}"

# We have recipes-* directories, add to BBFILES
BBFILES += "${LAYERDIR}/recipes-*/*/*.bb ${LAYERDIR}/recipes-*/*/*.bbappend"

BBFILE_COLLECTIONS += "meta-fluke-cda"
BBFILE_PATTERN_meta-fluke-cda = "^${LAYERDIR}/"
BBFILE_PRIORITY_meta-fluke-cda = "6"

# This should only be incremented on significant changes that will
# cause compatibility issues with other layers
LAYERVERSION_meta-fluke-cda = "1"

LAYERDEPENDS_meta-fluke-cda = "meta-altera"

LAYERSERIES_COMPAT_meta-fluke-cda = "zeus hardknott"
```

## conf/machine/fluke-cda-caldera.conf
```bitbake
#@TYPE: Machine
#@NAME: fluke-cda-caldera
#@DESCRIPTION: Machine configuration for the Cyclone V Fluke CDA Caldera"

require conf/machine/include/socfpga.inc

PREFERRED_PROVIDER_virtual/kernel = "linux-altera-lts"
PREFERRED_VERSION_linux-altera-lts = "5.4.%"

# change DEFAULTTUNE from armv7athf-neon to armv7athf to disable use of NEON
# since the NEON implementation in armv7a is not compliant with IEEE-754 
# floating point
DEFAULTTUNE = "armv7athf"

PREFERRED_PROVIDER_virtual/bootloader ?= "u-boot-socfpga"
PREFERRED_VERSION_u-boot-socfpga ?= "v2016.11%"

UBOOT_CONFIG ??= "fluke-cda-caldera"
UBOOT_CONFIG[fluke-cda-caldera] = "socfpga_fluke_cda_caldera_defconfig"

KMACHINE = "fluke-cda-caldera"

# Default kernel devicetrees
KERNEL_DEVICETREE ?= "\
	Caldera_soc.dtb \
"
SPL_BINARY_fluke-cda-caldera = "u-boot-with-spl.sfp"

MKUBIFS_ARGS = "-m 1 -e 65408 -c 4094"
UBINIZE_ARGS = "-m 1 -p 64KiB"
```

## conf/machine/fluke-cda-nighthawk.conf
```bitbake
#@TYPE: Machine
#@NAME: fluke-cda-nighthawk
#@DESCRIPTION: Machine configuration for the Cyclone V Fluke CDA Nighthawk"

require conf/machine/include/socfpga.inc

# change DEFAULTTUNE from armv7athf-neon to armv7athf to disable use of NEON
# since the NEON implementation in armv7a is not compliant with IEEE-754 
# floating point
DEFAULTTUNE = "armv7athf"

PREFERRED_PROVIDER_virtual/kernel = "linux-altera-lts"
PREFERRED_VERSION_linux-altera-lts = "5.4.%"

PREFERRED_PROVIDER_virtual/bootloader ?= "u-boot-socfpga"
PREFERRED_VERSION_u-boot-socfpga ?= "v2016.11%"

UBOOT_CONFIG ??= "fluke-cda-nighthawk"
UBOOT_CONFIG[fluke-cda-nighthawk] = "socfpga_fluke_cda_nighthawk_defconfig"

KMACHINE = "fluke-cda-nighthawk"

# Default kernel devicetrees
KERNEL_DEVICETREE ?= "\
	Nighthawk_soc.dtb \
"
SPL_BINARY_fluke-cda-nighthawk = "u-boot-with-spl.sfp"

MKUBIFS_ARGS = "-m 1 -e 65408 -c 4094"
UBINIZE_ARGS = "-m 1 -p 64KiB"

#create partitioned disk image for eMMC using wic
IMAGE_FSTYPES_append = " wic.gz"
#IMAGE_FSTYPES_remove = "ubi"
#wic file for building partitioned disk image
WKS_FILE = "sdimage-${MACHINE}.wks.in"
```

## conf/machine/fluke-cda-richmond.conf
```bitbake
#@TYPE: Machine
#@NAME: fluke-cda-richmond
#@DESCRIPTION: Machine configuration for the Cyclone V Fluke CDA Richmond"

require conf/machine/include/socfpga.inc

PREFERRED_PROVIDER_virtual/kernel = "linux-altera-lts"
PREFERRED_VERSION_linux-altera-lts = "5.4.%"

# change DEFAULTTUNE from armv7athf-neon to armv7athf to disable use of NEON
# since the NEON implementation in armv7a is not compliant with IEEE-754 
# floating point
DEFAULTTUNE = "armv7athf"

PREFERRED_PROVIDER_virtual/bootloader ?= "u-boot-socfpga"
PREFERRED_VERSION_u-boot-socfpga ?= "v2016.11%"

UBOOT_CONFIG ??= "fluke-cda-richmond"
UBOOT_CONFIG[fluke-cda-richmond] = "socfpga_fluke_cda_richmond_defconfig"

KMACHINE = "fluke-cda-richmond"

# Default kernel devicetrees
KERNEL_DEVICETREE ?= "\
	Richmond_soc.dtb \
"
SPL_BINARY_fluke-cda-richmond = "u-boot-with-spl.sfp"

MKUBIFS_ARGS = "-m 1 -e 65408 -c 4094"
UBINIZE_ARGS = "-m 1 -p 64KiB"
```

## conf/machine/fluke-cda-triclamp.conf
```bitbake
#@TYPE: Machine
#@NAME: fluke-cda-triclamp
#@DESCRIPTION: Machine configuration for the Cyclone V Fluke CDA Triclamp"

require conf/machine/include/socfpga.inc

PREFERRED_PROVIDER_virtual/kernel ?= "linux-altera-ltsi"
PREFERRED_VERSION_linux-altera-ltsi ?= "4.1%"

PREFERRED_PROVIDER_virtual/bootloader ?= "u-boot-socfpga"
PREFERRED_VERSION_u-boot-socfpga ?= "v2016.11%"

UBOOT_CONFIG ??= "fluke-cda-triclamp"
UBOOT_CONFIG[fluke-cda-triclamp] = "socfpga_fluke_cda_triclamp_defconfig"

KMACHINE = "fluke-cda-triclamp"

# Default kernel devicetrees
KERNEL_DEVICETREE ?= "\
	Triclamp_soc.dtb \
"
SPL_BINARY_fluke-cda-triclamp = "u-boot-with-spl.sfp"

MKUBIFS_ARGS = "-m 1 -e 65408 -c 4094"
UBINIZE_ARGS = "-m 1 -p 64KiB"
```

## conf/machine/fluke-cda-vanquish.conf
```bitbake
#@TYPE: Machine
#@NAME: fluke-cda-vanquish
#@DESCRIPTION: Machine configuration for the Cyclone V Fluke CDA Vanquish"

require conf/machine/include/socfpga.inc

PREFERRED_PROVIDER_virtual/kernel = "linux-altera-lts"
PREFERRED_VERSION_linux-altera-lts = "5.4.%"

# change DEFAULTTUNE from armv7athf-neon to armv7athf to disable use of NEON
# since the NEON implementation in armv7a is not compliant with IEEE-754 
# floating point
DEFAULTTUNE = "armv7athf"

PREFERRED_PROVIDER_virtual/bootloader ?= "u-boot-socfpga"
PREFERRED_VERSION_u-boot-socfpga ?= "v2016.11%"

UBOOT_CONFIG ??= "fluke-cda-vanquish"
UBOOT_CONFIG[fluke-cda-vanquish] = "socfpga_fluke_cda_vanquish_defconfig"

KMACHINE = "fluke-cda-vanquish"

# Default kernel devicetrees
KERNEL_DEVICETREE ?= "\
	Vanquish_soc.dtb \
"
SPL_BINARY_fluke-cda-vanquish = "u-boot-with-spl.sfp"

MKUBIFS_ARGS = "-m 1 -e 65408 -c 4094"
UBINIZE_ARGS = "-m 1 -p 64KiB"
```

## wic/sdimage-fluke-cda-nighthawk.wks
```
# short-description: Create an SD card image for fluke-cda-nighthawk
# long-description: Create an SD card image for fluke-cda-nighthawk.
# The root FS is located in the first ext4 partition and a backup of the 
# original factory root FS in the second.

part / --source rootfs --ondisk mmcblk0 --fstype=ext4 --mkfs-extraopts="-O^huge_file -F -i 4096" --label root --align 4 --overhead-factor 1.0
part /mnt/factory_fs --source rootfs --ondisk mmcblk0 --fstype=ext4 --fsoptions "ro" --mkfs-extraopts="-O^huge_file -F -i 4096" --label factory --align 4 --overhead-factor 1.0
part swap --size 512 --ondisk mmcblk0 --fstype=swap --label swap --align 4 --overhead-factor 1.0
```
